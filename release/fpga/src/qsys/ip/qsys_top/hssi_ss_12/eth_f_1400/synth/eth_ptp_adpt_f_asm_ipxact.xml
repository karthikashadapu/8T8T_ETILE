# ptp_adpt_f_asm: IP-XACT component
VLNV Vendor:Library:ptp_adpt_f_asm:1.0

## Bus interfaces (logical=physical port)
ptp_adpt_f_asm_slave: slave Magillem:MRV:MRVBusDef:1.0, memory map ptp_adpt_f_asm
  parameters _mre_definition_=ptp_adpt_f_asm

## Address spaces and blocks
ptp_adpt_f_asm.ptp_adpt_f_asm_block: base 0x0, range 0x5240, width 32, register

## Registers
Registers are 32-bit, read-write, reset 0x0 unless marked. A register's access mark holds for its fields unless they carry their own. Offsets are from the block's base; lines under a group give offsets from that group; [hi:lo] are bit positions; {n}, {i} and the like mark numbered series; 'fields as' and 'values as' point back to an identical list; <NAME> marks a mode.

## ptp_adpt_f_asm.ptp_adpt_f_asm_block
Base 0x00000000
0x5000 ptp_asm_cfg group
  {0x40+4j} tx_asm{j} (j=0..127) — <b>Asymmetry delay</b><p>32b reg allocated for PTP asymmetry delay adjustment</p>
    [23:0] asm — <b>Asymmetry delay</b><p>24b field specifying asymmetry delay magnitude</p><br> <ul> Bits [23:8] Magnitude in nanoseconds Bits [ 7:0] Magnitude in fractional nanoseconds </ul>
