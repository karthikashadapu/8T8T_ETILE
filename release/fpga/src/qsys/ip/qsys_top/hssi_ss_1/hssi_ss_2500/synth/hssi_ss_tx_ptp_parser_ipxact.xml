# parser_gen: IP-XACT component
VLNV Vendor:Library:parser_gen:1.0

## Bus interfaces (logical=physical port)
parser_gen_slave: slave Magillem:MRV:MRVBusDef:1.0, memory map parser_gen
  parameters _mre_definition_=parser_gen

## Address spaces and blocks
parser_gen.parser_gen_block: base 0x0, range 0x200, width 32, register

## Registers
Registers are 32-bit, read-write, reset 0x0 unless marked. A register's access mark holds for its fields unless they carry their own. Offsets are from the block's base; lines under a group give offsets from that group; [hi:lo] are bit positions; {n}, {i} and the like mark numbered series; 'fields as' and 'values as' point back to an identical list; <NAME> marks a mode.

## parser_gen.parser_gen_block
Base 0x00000000
0x100 lcntr_0 — recognized pkts number
  [31:0] cntr — <b> low cntr </b>
0x104 hcntr_0 — recognized pkts number
  [15:0] cntr — <b> high cntr </b>
0x108 lcntr_1 — non recognized pkts number
  [31:0] cntr — <b> low cntr </b>
0x10C hcntr_1 — non recognized pkts number
  [15:0] cntr — <b> high cntr </b>
0x110 lcntr_2 — [eth] (type) ptp [PTPv2]
  [31:0] cntr — <b> low cntr </b>
0x114 hcntr_2 — [eth] (type) ptp [PTPv2]
  [15:0] cntr — <b> high cntr </b>
0x118 lcntr_3 — [eth] (type) ipv4 [ipv4] [udp] (dport) ptp_ev [PTPv2]
  [31:0] cntr — <b> low cntr </b>
0x11C hcntr_3 — [eth] (type) ipv4 [ipv4] [udp] (dport) ptp_ev [PTPv2]
  [15:0] cntr — <b> high cntr </b>
0x120 lcntr_4 — [eth] (type) ipv4 [ipv4] [udp] (dport) ptp_msc [PTPv2]
  [31:0] cntr — <b> low cntr </b>
0x124 hcntr_4 — [eth] (type) ipv4 [ipv4] [udp] (dport) ptp_msc [PTPv2]
  [15:0] cntr — <b> high cntr </b>
0x128 lcntr_5 — [eth] (type) ipv6 [ipv6] [udp] (dport) ptp_ev [PTPv2]
  [31:0] cntr — <b> low cntr </b>
0x12C hcntr_5 — [eth] (type) ipv6 [ipv6] [udp] (dport) ptp_ev [PTPv2]
  [15:0] cntr — <b> high cntr </b>
0x130 lcntr_6 — [eth] (type) ipv6 [ipv6] [udp] (dport) ptp_msc [PTPv2]
  [31:0] cntr — <b> low cntr </b>
0x134 hcntr_6 — [eth] (type) ipv6 [ipv6] [udp] (dport) ptp_msc [PTPv2]
  [15:0] cntr — <b> high cntr </b>
0x138 lcntr_7 — [eth] (type) vlan [vlan] (type) vlan [vlan2] (type) ptp [PTPv2]
  [31:0] cntr — <b> low cntr </b>
0x13C hcntr_7 — [eth] (type) vlan [vlan] (type) vlan [vlan2] (type) ptp [PTPv2]
  [15:0] cntr — <b> high cntr </b>
0x140 lcntr_8 — [eth] (type) vlan [vlan] (type) vlan [vlan2] (type) ipv4 [ipv4] [udp] (dport) ptp_ev [PTPv2]
  [31:0] cntr — <b> low cntr </b>
0x144 hcntr_8 — [eth] (type) vlan [vlan] (type) vlan [vlan2] (type) ipv4 [ipv4] [udp] (dport) ptp_ev [PTPv2]
  [15:0] cntr — <b> high cntr </b>
0x148 lcntr_9 — [eth] (type) vlan [vlan] (type) vlan [vlan2] (type) ipv4 [ipv4] [udp] (dport) ptp_msc [PTPv2]
  [31:0] cntr — <b> low cntr </b>
0x14C hcntr_9 — [eth] (type) vlan [vlan] (type) vlan [vlan2] (type) ipv4 [ipv4] [udp] (dport) ptp_msc [PTPv2]
  [15:0] cntr — <b> high cntr </b>
0x150 lcntr_10 — [eth] (type) vlan [vlan] (type) vlan [vlan2] (type) ipv6 [ipv6] [udp] (dport) ptp_ev [PTPv2]
  [31:0] cntr — <b> low cntr </b>
0x154 hcntr_10 — [eth] (type) vlan [vlan] (type) vlan [vlan2] (type) ipv6 [ipv6] [udp] (dport) ptp_ev [PTPv2]
  [15:0] cntr — <b> high cntr </b>
0x158 lcntr_11 — [eth] (type) vlan [vlan] (type) vlan [vlan2] (type) ipv6 [ipv6] [udp] (dport) ptp_msc [PTPv2]
  [31:0] cntr — <b> low cntr </b>
0x15C hcntr_11 — [eth] (type) vlan [vlan] (type) vlan [vlan2] (type) ipv6 [ipv6] [udp] (dport) ptp_msc [PTPv2]
  [15:0] cntr — <b> high cntr </b>
0x160 lcntr_12 — [eth] (type) vlan [vlan] (type) ptp [PTPv2]
  [31:0] cntr — <b> low cntr </b>
0x164 hcntr_12 — [eth] (type) vlan [vlan] (type) ptp [PTPv2]
  [15:0] cntr — <b> high cntr </b>
0x168 lcntr_13 — [eth] (type) vlan [vlan] (type) ipv4 [ipv4] [udp] (dport) ptp_ev [PTPv2]
  [31:0] cntr — <b> low cntr </b>
0x16C hcntr_13 — [eth] (type) vlan [vlan] (type) ipv4 [ipv4] [udp] (dport) ptp_ev [PTPv2]
  [15:0] cntr — <b> high cntr </b>
0x170 lcntr_14 — [eth] (type) vlan [vlan] (type) ipv4 [ipv4] [udp] (dport) ptp_msc [PTPv2]
  [31:0] cntr — <b> low cntr </b>
0x174 hcntr_14 — [eth] (type) vlan [vlan] (type) ipv4 [ipv4] [udp] (dport) ptp_msc [PTPv2]
  [15:0] cntr — <b> high cntr </b>
0x178 lcntr_15 — [eth] (type) vlan [vlan] (type) ipv6 [ipv6] [udp] (dport) ptp_ev [PTPv2]
  [31:0] cntr — <b> low cntr </b>
0x17C hcntr_15 — [eth] (type) vlan [vlan] (type) ipv6 [ipv6] [udp] (dport) ptp_ev [PTPv2]
  [15:0] cntr — <b> high cntr </b>
0x180 lcntr_16 — [eth] (type) vlan [vlan] (type) ipv6 [ipv6] [udp] (dport) ptp_msc [PTPv2]
  [31:0] cntr — <b> low cntr </b>
0x184 hcntr_16 — [eth] (type) vlan [vlan] (type) ipv6 [ipv6] [udp] (dport) ptp_msc [PTPv2]
  [15:0] cntr — <b> high cntr </b>
0x1F8 axil_const0 — axil_const_0([15:0]=ptp_result_0,[31:16]=ptp_result1)
  [31:0] constant — <b> axi lite constant </b>
0x1FC axil_const1 — axil_const_1(preamble_en)
  [31:0] constant — <b> axi lite constant </b>
